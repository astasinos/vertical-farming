## prj.conf
```kconfig
CONFIG_SERIAL=y
CONFIG_UART_INTERRUPT_DRIVEN=y

# General config
CONFIG_HEAP_MEM_POOL_SIZE=4096
CONFIG_NEWLIB_LIBC=y

# Networking
CONFIG_NETWORKING=y
CONFIG_NET_NATIVE=n
CONFIG_NET_SOCKETS_OFFLOAD=y
CONFIG_NET_SOCKETS=y
CONFIG_NET_SOCKETS_POSIX_NAMES=y

# LTE link control
CONFIG_LTE_LINK_CONTROL=y
CONFIG_LTE_AUTO_INIT_AND_CONNECT=y

# LTE parameters
## Network Mode / LTE category
CONFIG_LTE_NETWORK_MODE_NBIOT=y
CONFIG_LTE_MODE_PREFERENCE_AUTO=n
CONFIG_LTE_MODE_PREFERENCE_NBIOT=y
CONFIG_LTE_LC_MODEM_SLEEP_NOTIFICATIONS=y

# Modem library
CONFIG_NRF_MODEM_LIB=y
CONFIG_NRF_MODEM_LIB_TRACE_ENABLED=n

# CoAP
CONFIG_COAP=y
CONFIG_AT_HOST_LIBRARY=y

# Main thread
CONFIG_MAIN_STACK_SIZE=4096

CONFIG_NET_IPV6=y

# LOGGING
CONFIG_LOG=y

# Power management
CONFIG_PM=y
CONFIG_EVENTS=y

# CALENDAR TIME
CONFIG_DATE_TIME=y
CONFIG_DATE_TIME_AUTO_UPDATE=y

# STATE MACHINE FRAMEWORK
CONFIG_SMF=y

CONFIG_GPIO=y
CONFIG_SYSTEM_WORKQUEUE_STACK_SIZE=4096
CONFIG_LTE_NETWORK_TIMEOUT=1200
```

## src/main.c
```c
// --- includes ----------------------------------------------------------------
#include <zephyr.h>
#include "../internal_uart/internal_uart.h"
#include "../gpioif/gpio_interface.h"

// --- functions definitions ---------------------------------------------------
void main(void)
{
    internal_uart_init();
    gpio_row_control_init();
}
```
