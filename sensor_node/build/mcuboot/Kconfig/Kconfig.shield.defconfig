## sensor_node/build_dongle/Kconfig/Kconfig.shield
```kconfig
osource "c:/Projects/Thesis/vertical_farming/project/peripheral_lbs/boards/shields/*/Kconfig.shield"
osource "C:/Users/dawnm/ncs/v1.9.1/nrf/boards/shields/*/Kconfig.shield"
```

## sensor_node/build_dongle/Kconfig/Kconfig.shield.defconfig
```kconfig
osource "c:/Projects/Thesis/vertical_farming/project/peripheral_lbs/boards/shields/*/Kconfig.defconfig"
osource "C:/Users/dawnm/ncs/v1.9.1/nrf/boards/shields/*/Kconfig.defconfig"
```
